## EspSw2/buildConfigs/BusRaider/sdkconfig.defaults
```kconfig
# Define configuration
# Remove/repace these comments to set level to debug/info

#CONFIG_LOG_DEFAULT_LEVEL_DEBUG=y
#CONFIG_LOG_DEFAULT_LEVEL=4

# Serial Baud-Rate
CONFIG_ESP_CONSOLE_UART_BAUDRATE=115200

# Serial flasher config
CONFIG_ESPTOOLPY_FLASHSIZE_4MB=y
CONFIG_ESPTOOLPY_FLASHSIZE="4MB"

# Partition Table
CONFIG_PARTITION_TABLE_CUSTOM=y
CONFIG_PARTITION_TABLE_CUSTOM_FILENAME="buildConfigs/BusRaider/partitions.csv"

# Bluetooth
CONFIG_BT_ENABLED=y
CONFIG_BTDM_CTRL_MODE_BLE_ONLY=y
CONFIG_BT_NIMBLE_ENABLED=y
CONFIG_BT_NIMBLE_SVC_GAP_DEVICE_NAME="BusRaider"
CONFIG_BT_NIMBLE_ROLE_CENTRAL=n
CONFIG_BT_NIMBLE_ROLE_OBSERVER=n
CONFIG_BT_NIMBLE_CRYPTO_STACK_MBEDTLS=n
CONFIG_BT_NIMBLE_LOG_LEVEL_WARNING=y
#CONFIG_BT_NIMBLE_MEM_ALLOC_MODE_EXTERNAL=y

# Common ESP-related
#CONFIG_ESP_MAIN_TASK_STACK_SIZE=20000
#CONFIG_ESP_IPC_TASK_STACK_SIZE=10000
#CONFIG_ESP_TASK_WDT_PANIC=y

# LWIP
CONFIG_LWIP_LOCAL_HOSTNAME="BusRaider"
CONFIG_LWIP_SO_RCVBUF=y
CONFIG_LWIP_SO_LINGER=y
CONFIG_LWIP_L2_TO_L3_COPY=y

# FreeRTOS
CONFIG_FREERTOS_HZ=1000
CONFIG_FREERTOS_USE_TRACE_FACILITY=y
CONFIG_FREERTOS_USE_STATS_FORMATTING_FUNCTIONS=y
CONFIG_FREERTOS_VTASKLIST_INCLUDE_COREID=y
CONFIG_FREERTOS_GENERATE_RUN_TIME_STATS=y

# For MicroPython
CONFIG_FREERTOS_SUPPORT_STATIC_ALLOCATION=y
CONFIG_FREERTOS_THREAD_LOCAL_STORAGE_POINTERS=2

# SPIRAM
CONFIG_ESP32_SPIRAM_SUPPORT=n
CONFIG_SPIRAM_CACHE_WORKAROUND=n
CONFIG_SPIRAM_BOOT_INIT=y
CONFIG_SPIRAM_IGNORE_NOTFOUND=y
CONFIG_SPIRAM_USE_MEMMAP=
CONFIG_SPIRAM_USE_CAPS_ALLOC=y
CONFIG_SPIRAM_USE_MALLOC=
CONFIG_SPIRAM_TYPE_AUTO=y
CONFIG_SPIRAM_TYPE_ESPPSRAM32=
CONFIG_SPIRAM_TYPE_ESPPSRAM64=
CONFIG_SPIRAM_SIZE=-1
CONFIG_SPIRAM_SPEED_40M=y
CONFIG_SPIRAM_MEMTEST=n
CONFIG_SPIRAM_BANKSWITCH_ENABLE=y
CONFIG_SPIRAM_BANKSWITCH_RESERVE=8
CONFIG_SPIRAM_TRY_ALLOCATE_WIFI_LWIP=y
CONFIG_SPIRAM_ALLOW_BSS_SEG_EXTERNAL_MEMORY=
#CONFIG_SPIRAM_MALLOC_RESERVE_INTERNAL=0
#CONFIG_BT_ALLOCATION_FROM_SPIRAM_FIRST=y
#CONFIG_SPIRAM_ALLOW_NOINIT_SEG_EXTERNAL_MEMORY=y

# Uncomment the following for heap-tracing support
#CONFIG_HEAP_TRACING_OFF=y
#CONFIG_HEAP_TRACING_STANDALONE=y
#CONFIG_HEAP_TRACING_STACK_DEPTH=5

# To reduce iRAM usage
CONFIG_ESP32_WIFI_IRAM_OPT=n
CONFIG_ESP32_WIFI_RX_IRAM_OPT=n
```

## EspSw2/sdkconfig.defaults
```kconfig
# Define configuration
# Remove/repace these comments to set level to debug/info

#CONFIG_LOG_DEFAULT_LEVEL_DEBUG=y
#CONFIG_LOG_DEFAULT_LEVEL=4

# Serial flasher config
CONFIG_ESPTOOLPY_FLASHSIZE_4MB=y
CONFIG_ESPTOOLPY_FLASHSIZE="4MB"

# Partition Table
CONFIG_PARTITION_TABLE_CUSTOM=y
CONFIG_PARTITION_TABLE_FILENAME="partitions.csv"

# Bluetooth
CONFIG_BT_ENABLED=y
CONFIG_BTDM_CTRL_MODE_BLE_ONLY=y
CONFIG_BT_NIMBLE_ENABLED=y
CONFIG_BT_NIMBLE_SVC_GAP_DEVICE_NAME="BusRaider"
CONFIG_BT_NIMBLE_ROLE_CENTRAL=n
CONFIG_BT_NIMBLE_CRYPTO_STACK_MBEDTLS=n

# Common ESP-related
#CONFIG_ESP_MAIN_TASK_STACK_SIZE=10000
#CONFIG_ESP_IPC_TASK_STACK_SIZE=10000
#CONFIG_ESP_TASK_WDT_PANIC=y

# LWIP
CONFIG_LWIP_LOCAL_HOSTNAME="BusRaider"
CONFIG_LWIP_SO_RCVBUF=y
CONFIG_LWIP_SO_LINGER=y
CONFIG_LWIP_L2_TO_L3_COPY=y

# FreeRTOS
CONFIG_FREERTOS_HZ=1000
CONFIG_FREERTOS_USE_TRACE_FACILITY=y
CONFIG_FREERTOS_USE_STATS_FORMATTING_FUNCTIONS=y
CONFIG_FREERTOS_VTASKLIST_INCLUDE_COREID=y
CONFIG_FREERTOS_GENERATE_RUN_TIME_STATS=y
```
